## firmware/components/net_svc/Kconfig
```kconfig
menu "AI-Gauge updates"

    config AI_GAUGE_UPDATE_REPO
        string "GitHub repository that publishes firmware releases"
        default "JosephGarrone/ai-gauge"
        help
            owner/name of the repository whose latest release the gauge updates from. The release
            must carry ota.json and ai-gauge.bin, which release.yml attaches (docs/ci-release.md).
            A fork that publishes its own releases changes this.

    config AI_GAUGE_UPDATE_AUTO_CHECK
        bool "Check for updates automatically while on WiFi"
        default y
        help
            Look for a newer release a minute after connecting, then twice a day. Only checks:
            installing always takes a confirmed tap on the settings page or POST /api/update/install,
            because an install restarts the gauge.

endmenu
```

## firmware/main/Kconfig.projbuild
```kconfig
menu "AI-Gauge"

config AI_GAUGE_SIMULATED_SOURCE
    bool "Sweep simulated values until a sensor board answers"
    default y
    help
        Sweeps the gauge across its full range while no sensor board has answered since
        startup, so the renderer can be exercised on a bare display with nothing wired to the
        expansion header. Once a board has been seen, a sensor fault shows as dashes and the
        sweep does not return until the next restart.

        Turn this off for an installed gauge: a missing board then shows dashes from the
        start instead of a moving needle.

config AI_GAUGE_BENCH_TRANSITION
    bool "Benchmark the tile transition"
    default n
    help
        Repeatedly animates between the dial and settings tiles and reports the frame cost,
        so scenario 4 in docs/performance.md can be measured without a human swiping. The
        transition redraws the whole screen for the duration of the animation and is the
        most expensive thing the UI does.

        Leave this off for normal use: it makes the display unusable.

config AI_GAUGE_REMOTE_CONTROL
    bool "Screenshots and touch gestures over HTTP"
    default y
    help
        GET /api/screenshot returns the screen as a BMP, and POST /api/input plays a tap, long
        press or swipe, so the UI can be driven and inspected without touching the gauge
        (docs/networking.md). Unauthenticated like the rest of the API: anyone on the network can
        see and operate the screen. Turn it off for a build that should not allow that.

endmenu
```
